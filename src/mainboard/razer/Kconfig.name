## src/mainboard/razer/blade_stealth_icl/Kconfig
```kconfig
if BOARD_RAZER_BLADE_STEALTH_ICL

config BOARD_SPECIFIC_OPTIONS
	def_bool y
	select BOARD_ROMSIZE_KB_16384
	select EC_ACPI
	select PLATFORM_USES_FSP2_0
	select GENERIC_SPD_BIN
	select HAVE_ACPI_RESUME
	select HAVE_ACPI_TABLES
	select GENERIC_SPD_BIN
	select DRIVERS_I2C_HID
	select DRIVERS_I2C_GENERIC
	select DRIVERS_USB_ACPI
	select SOC_INTEL_COMMON_BLOCK_HDA_VERB
	select SOC_INTEL_ICELAKE
	select MAINBOARD_USES_IFD_EC_REGION
	select ADD_FSP_BINARIES
	select FSP_USE_REPO

config MAINBOARD_DIR
	string
	default "razer/blade_stealth_icl"

config MAINBOARD_PART_NUMBER
	string
	default "L"

config MAINBOARD_FAMILY
	string
	default "BLADE_STEALTH"

config MAX_CPUS
	int
	default 4

config UART_FOR_CONSOLE
	int
	default 2

config NO_POST
	default y

endif
```

## src/mainboard/razer/blade_stealth_kbl/Kconfig
```kconfig
if BOARD_RAZER_BLADE_STEALTH_KBL

config BOARD_SPECIFIC_OPTIONS
	def_bool y
	select SYSTEM_TYPE_LAPTOP
	select BOARD_ROMSIZE_KB_8192
	select SUPERIO_ITE_IT8528E
	select SOC_INTEL_KABYLAKE
	select MAINBOARD_USES_FSP2_0
	select MAINBOARD_HAS_LPC_TPM
	select MAINBOARD_HAS_TPM2
	select GENERIC_SPD_BIN
	select HAVE_ACPI_RESUME
	select HAVE_ACPI_TABLES
	select HAVE_IFD_BIN
	select HAVE_ME_BIN
	select ADD_FSP_BINARIES
	select FSP_USE_REPO # mainline compatible?
	select CHECK_ME # only-dev
	select CONSOLE_SPI_FLASH # only-dev
	select CCACHE # only-dev

	config IRQ_SLOT_COUNT
		int
		default 18

	config MAINBOARD_VENDOR
		string
		default "RAZER"

	config MAINBOARD_FAMILY
		string
		default "BLADE_STEALTH"

	config MAINBOARD_PART_NUMBER
		string
		default "H2U"

	config MAINBOARD_VERSION
		string
		default "1.0"

	config MAINBOARD_DIR
		string
		default "razer/blade_stealth_kbl"

	config DEVICETREE
		string
		default "devicetree.cb"

	config MAX_CPUS
		int
		default 4

	config NO_POST
		def_bool y
		help
			This platform does not have any way to see POST codes
			so disable them by default.

	config VGA_BIOS_ID
		string
		default "8086,5917"

	config CPU_MICROCODE_CBFS_LEN
		hex
		default 0x18000

	config CPU_MICROCODE_CBFS_LOC
		hex
		default 0xFFE115A0

	config CBFS_SIZE
		hex
		default 0x5c0000

endif
```
